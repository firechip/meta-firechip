## meta-firechip/conf/layer.conf
```bitbake
# We have a conf and classes directory, add to BBPATH
BBPATH .= ":${LAYERDIR}"

# We have a recipes-* directories, add to BBFILES
BBFILES += "${LAYERDIR}/recipes-*/*/*.bb \
            ${LAYERDIR}/recipes-*/*/*.bbappend"

BBFILE_COLLECTIONS += "firechip-layer"
BBFILE_PATTERN_firechip-layer = "^${LAYERDIR}/"
BBFILE_PRIORITY_firechip-layer = "6"

LAYERVERSION ?= "1"
```
